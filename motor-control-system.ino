const byte motorPWM = 32;
const byte motorDIR = 33;

const byte EPhaseA = 34;
const byte EPhaseB = 35;

const float Kp = 1.0;
const float Ki = 0.05;
const float Kd = 0.02;

float integral = 0;
float previousPV = 0;

volatile long encoderCount = 0;
const int COUNTS_PER_REV = 1375; //experimental value
const byte PWM_MAX = 255;
const int INTEGRAL_LIMIT = 1000;
long setpoint = 0;

unsigned long prevTime = 0;

void encoderISR() {
  int A = digitalRead(EPhaseA);
  int B = digitalRead(EPhaseB);

  if(A == B) {
    encoderCount++;
  } else {
    encoderCount--;
  }
}

void setMotor(int value) {
  value = constrain(value, -PWM_MAX, PWM_MAX);

  if (value > 0) {
    digitalWrite(motorDIR, HIGH);
    analogWrite(motorPWM, value);
  } else if (value < 0) {
    digitalWrite(motorDIR, LOW);
    analogWrite(motorPWM, -value);
  } else {
    analogWrite(motorPWM, 0);
  }
}

float getShortestError(long SP, long PV) {
  long error = SP - PV;

  if (error > COUNTS_PER_REV / 2) {
    error -= COUNTS_PER_REV;
  } else if (error < -COUNTS_PER_REV / 2) {
    error += COUNTS_PER_REV;
  }

  return (float)error;
}

int updatePID(long SP, long PV, float dt) {
  float error = getShortestError(SP, PV);

  integral += error*dt;

  integral = constrain(integral, -INTEGRAL_LIMIT, INTEGRAL_LIMIT);

  float derivative = -(PV - previousPV) / dt;

  float output = Kp*error + Ki*integral + Kd*derivative;
  output = constrain(output, -PWM_MAX, PWM_MAX);

  previousPV = PV;
  return (int) output;
}

void setup() {
  pinMode(motorPWM, OUTPUT);
  pinMode(motorDIR, OUTPUT);

  // encoder has internal pullup so no pullup @ microcontroller needed
  pinMode(EPhaseA, INPUT);
  pinMode(EPhaseB, INPUT);

  attachInterrupt(digitalPinToInterrupt(EPhaseA), encoderISR, CHANGE);

  Serial.begin(115200);

  setMotor(0);

  prevTime = micros();
}

void loop() {
  if (Serial.available()) {
    setpoint = Serial.parseInt();

    integral = 0;

    noInterrupts();
    previousPV = encoderCount;
    interrupts();

    Serial.print("New target: ");
    Serial.println(setpoint);
  }

  unsigned long now = micros();

  if (now - prevTime >= 1000) {
    float dt = (now - prevTime) / 1000000.0;

    prevTime = now;
    
    noInterrupts();
    long position = encoderCount;
    interrupts();

    int motorCommand = updatePID(setpoint, position, dt);

    setMotor(motorCommand);
  }
}